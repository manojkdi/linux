/dts-v1/;
/plugin/;

/ {
    compatible = "brcm,bcm2835";

    fragment@0 {
        target-path = "/";
        __overlay__ {
            w1: onewire {
                compatible = "w1-gpio";
                pinctrl-names = "default";
                pinctrl-0 = <&w1_pins>;
                gpios = <&gpio 4 0>;
                status = "okay";

                // Default timing values for 1-Wire communication (in nanoseconds)
                // These values are inspired by the article from Analog Devices:
                // https://www.analog.com/en/resources/technical-articles/1wire-communication-through-software.html
                //index 0 is delay value for standard mode and index 1 is delay value for overdrive mode
                //Note: tSLOT = tW0L + tREC.   As well,  tRL = tW1L.  tRSTH = tPDH + tPDL + tREC in some 1w devices.
                w1_delay_values = /bits/ 64 <
                    6000    1000    // Initialization low pulse duration and release   (A/tW1L)
                    64000   7500    // Presence detect wait and sample                 (B/tSLOT-tW1L)
                    60000   7500    // Recovery time between commands                  (C/tW0L)
                    10000   5000    // Write 1 low pulse and recovery                  (D/tREC)
                    9000    1000    // Write 0 low pulse and recovery                  (E/tW0L )
                    55000   7000    // Read low pulse and sample                       (F/tSLOT-tMSR)
                    0       2500    // Bus idle time between operations                (G/tREC directly prior to 1w reset cylce)
                    480000  50000   // Initialization high pulse duration and recovery (H/tRSTL)
                    70000   10000   // Overdrive initialization low pulse and release  (I/tMSP)
                    485000  50000   // Overdrive presence detect wait and sample       (J/tRSTH-tMSP)
                >;

                // Average timing values for writing bitto GPIO pin (in nanoseconds)
                write_bit_0_avg_ns = /bits/ 64 <500>; // Average time to write a '0' bit
                write_bit_1_avg_ns = /bits/ 64 <500>; // Average time to write a '1' bit

                // Average timing values for reading bit from GPIO pin (in nanoseconds)
                read_bit_avg_ns = /bits/ 64 <500>; // Average time to read a bit
            };
        };
    };

    fragment@1 {
        target = <&gpio>;
        __overlay__ {
            w1_pins: w1_pins {
                brcm,pins = <4>;
                brcm,function = <0>; // in (initially)
                brcm,pull = <0>; // off
            };
        };
    };

    __overrides__ {
        gpiopin = <&w1>,"gpios:4",
                  <&w1>,"reg:0",
                  <&w1_pins>,"brcm,pins:0",
                  <&w1_pins>,"reg:0";
        overdrive_mode = <&w1>,"overdrive_mode:0"; // Overdrive mode as an integer (1 for true, 0 for false)
        pullup; // Silently ignore unneeded parameter
    };
};
